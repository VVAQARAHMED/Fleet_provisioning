## CMakeLists.txt
```
#
# Copyright (c) 2020 Nordic Semiconductor
#
# SPDX-License-Identifier: LicenseRef-Nordic-5-Clause
#

cmake_minimum_required(VERSION 3.20.0)

find_package(Zephyr REQUIRED HINTS $ENV{ZEPHYR_BASE})
project(fleet_provision)

# NORDIC SDK APP START
target_sources(app PRIVATE src/main.c)
target_sources(app PRIVATE src/nvs_flash.c)
target_sources(app PRIVATE src/connectivity_interface.c)
target_sources(app PRIVATE src/fleet_provisioning.c)
target_sources(app PRIVATE src/mqtt_pub_sub.c)
target_sources(app PRIVATE src/shadow/shadow_payload.c)
target_sources(app PRIVATE claim-certs/ca-cert.pem)
# NORDIC SDK APP END

if (CONFIG_MQTT_HELPER_PROVISION_CERTIFICATES)
	message(WARNING "Credentials are exposed in non-secure memory. This should be avoided in production.")

	# Define the directory where certificate include files will be stored.
	set(app_certs_binary_dir ${APPLICATION_BINARY_DIR}/claim-certs)
	zephyr_include_directories(claim-cert)

	# Function to process a certificate file and create a corresponding .inc file and compiler definition
	# used in certs/mqtt-certs.h to assign C variables that are used in mqtt_helper.c.
	function(process_certificate definition_name file_name)
		set(cert_file ${APPLICATION_SOURCE_DIR}/${CONFIG_MQTT_HELPER_CERTIFICATES_FOLDER}/${file_name})
		if(EXISTS ${cert_file})
			message(STATUS "${file_name} found")

			get_filename_component(file_base_name ${file_name} NAME_WE)
            set(FILE_NAME ${file_base_name}_1)
			set(inc_file_name ${FILE_NAME}.inc)

			set(inc_file_path ${app_certs_binary_dir}/${inc_file_name})
			generate_inc_file_for_target(app ${cert_file} ${inc_file_path})

			# Define a compiler macro with the path to the generated .inc file,
			# allowing it to be included in the source code.
			add_definitions(-D${definition_name}="${inc_file_path}")
		endif()
	endfunction()

	# Process each certificate file by generating a .inc file and defining a corresponding macro.
process_certificate("MQTT_HELPER_CA_CERT_1" "ca-cert.pem")
endif()
zephyr_include_directories(src/)
#zephyr_include_directories(claim-certs)
zephyr_include_directories(src/shadow)
add_subdirectory_ifdef(CONFIG_WATCHDOG_APPLICATION src/watchdog)
zephyr_include_directories_ifdef(CONFIG_AWS_IOT_PROVISION_CERTIFICATES claim-certs)
```

## Kconfig
```
#
# Copyright (c) 2020 Nordic Semiconductor ASA
#
# SPDX-License-Identifier: LicenseRef-Nordic-5-Clause
#

menu "AWS IoT Sample Settings"

config AWS_IOT_SAMPLE_APP_VERSION
	string "Application version"
	default "v1.0.0"
rsource "src/watchdog/Kconfig"
config AWS_IOT_SAMPLE_JSON_MESSAGE_SIZE_MAX
	int "Maximum size of JSON messages"
	default 200
	help
	  Maximum size of JSON messages that are sent to AWS IoT.

config AWS_IOT_SAMPLE_PUBLICATION_INTERVAL_SECONDS
	int "Interval in seconds that the sample will publish data"
	default 60

config AWS_IOT_SAMPLE_CONNECTION_RETRY_TIMEOUT_SECONDS
	int "Number of seconds between each AWS IoT connection retry"
	default 30

config AWS_IOT_SAMPLE_DEVICE_ID_USE_HW_ID
	bool "Use HW ID as device ID"
	select AWS_IOT_CLIENT_ID_APP
	depends on HW_ID_LIBRARY
	help
	  Use the devices's hardware ID as device ID when connecting to AWS IOT

config AWS_IOT_FLEET_PROVISION_CHANGES
        bool "will enable changes related fleet provision in nrf9160"
	help
	  enable changed related to fleet provision in nrf Sdk

module = AWS_IOT_SAMPLE
module-str = AWS IoT sample
source "${ZEPHYR_BASE}/subsys/logging/Kconfig.template.log_config"

endmenu

menu "Zephyr Kernel"
source "Kconfig.zephyr"
endmenu
```

## prj.conf
```kconfig
#
# Copyright (c) 2020 Nordic Semiconductor ASA
#
# SPDX-License-Identifier: LicenseRef-Nordic-5-Clause
#

# General
CONFIG_AWS_IOT_SAMPLE_APP_VERSION="v1.0.1"
CONFIG_LOG=y
CONFIG_LOG_BUFFER_SIZE=2048
CONFIG_HW_ID_LIBRARY=y
CONFIG_ASSERT=y
CONFIG_JSON_LIBRARY=y
CONFIG_REBOOT=y
CONFIG_BOOTLOADER_MCUBOOT=y
CONFIG_MCUBOOT_IMG_MANAGER=y
# Heap and stacks
CONFIG_HEAP_MEM_POOL_SIZE=8096
CONFIG_MAIN_STACK_SIZE=8192
CONFIG_SYSTEM_WORKQUEUE_STACK_SIZE=12288
#CONFIG_NET_CONNECTION_MANAGER_MONITOR_STACK_SIZE=4096
CONFIG_NET_MGMT_EVENT_STACK_SIZE=8192
#CONFIG_NRF_MODEM_LIB_NET_IF_WORKQUEUE_STACK_SIZE=2048

# Network
CONFIG_NETWORKING=y
CONFIG_NET_NATIVE=y
CONFIG_NET_IPV4=y
CONFIG_NET_CONNECTION_MANAGER=y
# AT host library
CONFIG_LTE_LINK_CONTROL=y
CONFIG_MODEM_KEY_MGMT=y
#CONFIG_LTE_NETWORK_MODE_LTE_M=y
CONFIG_LTE_NETWORK_MODE_LTE_M_NBIOT=y
CONFIG_LTE_LOCK_BANDS=y                           
CONFIG_LTE_LOCK_BAND_MASK="10000000000000000000" 

CONFIG_LTE_UNLOCK_PLMN=y
# Heaps and stacks

# AWS IoT library
CONFIG_AWS_IOT=y
CONFIG_AWS_IOT_CLIENT_ID_STATIC=""
CONFIG_AWS_IOT_BROKER_HOST_NAME="abcxxeu-west-1.amazonaws.com"
CONFIG_AWS_IOT_SAMPLE_DEVICE_ID_USE_HW_ID=y
CONFIG_MQTT_HELPER_SEC_TAG=40
CONFIG_AWS_IOT_TOPIC_UPDATE_DELTA_SUBSCRIBE=n
CONFIG_AWS_IOT_TOPIC_GET_ACCEPTED_SUBSCRIBE=n
CONFIG_AWS_IOT_TOPIC_GET_REJECTED_SUBSCRIBE=n


# MQTT helper library

CONFIG_MQTT_HELPER=y
#CONFIG_MQTT_HELPER_SEC_TAG=201
CONFIG_MQTT_HELPER_LAST_WILL=y
CONFIG_MQTT_HELPER_STACK_SIZE=4096

# MQTT - Maximum MQTT keepalive timeout specified by AWS IoT Core
CONFIG_MQTT_KEEPALIVE=1200
CONFIG_MQTT_CLEAN_SESSION=y
CONFIG_MQTT_HELPER_PROVISION_CERTIFICATES=y
CONFIG_MQTT_HELPER_NATIVE_TLS=y
# Increased AWS IoT payload buffer to be able to receive large payloads when using native TLS.
CONFIG_MQTT_HELPER_PAYLOAD_BUFFER_LEN=8096

CONFIG_HW_ID_LIBRARY_SOURCE_IMEI=y
CONFIG_NET_SOCKETS_SOCKOPT_TLS=y
CONFIG_MQTT_HELPER_CERTIFICATES_FOLDER="claim-certs"

# Native network stack
CONFIG_NRF_SECURITY=y
CONFIG_MBEDTLS=y
CONFIG_MBEDTLS_ENABLE_HEAP=y
#CONFIG_MBEDTLS_HEAP_SIZE= 56320
#81920
CONFIG_MBEDTLS_RSA_C=y

# NET Sockets
CONFIG_NET_SOCKETS_TLS_MAX_CONTEXTS=1
CONFIG_AWS_IOT_FLEET_PROVISION_CHANGES=y
CONFIG_AWS_IOT_SAMPLE_PUBLICATION_INTERVAL_SECONDS=60



#NVS Configuration
CONFIG_FLASH=y

CONFIG_NVS=y
CONFIG_LOG=y
CONFIG_LOG_MODE_IMMEDIATE=y
CONFIG_NVS_LOG_LEVEL_DBG=y
CONFIG_REBOOT=y
CONFIG_MPU_ALLOW_FLASH_WRITE=y
CONFIG_FLASH_PAGE_LAYOUT=y
CONFIG_BOOT_BANNER=y
CONFIG_AWS_FOTA=y
CONFIG_AWS_JOBS=y

CONFIG_SERIAL=y
CONFIG_UART_INTERRUPT_DRIVEN=y
CONFIG_NRF_MODEM_LIB_TRACE=n
CONFIG_NRF_MODEM_LIB_TRACE_BACKEND_UART=n
#CONFIG_UART_1_INTERRUPT_DRIVEN=y
#CONFIG_UART_LINE_CTRL=n
CONFIG_CONSOLE=y
CONFIG_UART_CONSOLE=y



CONFIG_SYS_CLOCK_TICKS_PER_SEC=1000  
# Default for SysTick (1ms tick rate)
CONFIG_TICKLESS_KERNEL=n  
# Disable tickless mode if you need regular SysTick ticks
CONFIG_CLOCK_CONTROL=y    
# Enable clock control
CONFIG_CLOCK_CONTROL_NRF_K32SRC_XTAL=y 



CONFIG_WATCHDOG_APPLICATION=y
```

## overlay-native_tls.conf
```kconfig
# TLS configuration
CONFIG_MODEM_KEY_MGMT=y
CONFIG_NORDIC_SECURITY_BACKEND=y
CONFIG_NET_SOCKETS_SOCKOPT_TLS=y
CONFIG_NET_SOCKETS_TLS_MAX_CONTEXTS=2
CONFIG_NET_SOCKETS_TLS_SET_MAX_FRAGMENT_LENGTH=y
CONFIG_POSIX_MAX_FDS=10
# Enable Socket Logging for debug
CONFIG_NET_LOG=y
CONFIG_NET_SOCKETS_LOG_LEVEL_DBG=y
CONFIG_MBEDTLS=y
CONFIG_MBEDTLS_TLS_LIBRARY=y
CONFIG_MBEDTLS_ENABLE_HEAP=y
CONFIG_MBEDTLS_KEY_EXCHANGE_RSA_ENABLED=y
CONFIG_MBEDTLS_MAC_SHA256_ENABLED=y
CONFIG_MBEDTLS_SSL_IN_CONTENT_LEN=5120
CONFIG_MBEDTLS_SSL_OUT_CONTENT_LEN=4096
CONFIG_MBEDTLS_HEAP_SIZE=81920
CONFIG_MBEDTLS_SSL_SERVER_NAME_INDICATION=y
#Cipher Suite disable
CONFIG_MBEDTLS_CTR_DRBG_C=n
CONFIG_MBEDTLS_CHACHA20_C=n
CONFIG_MBEDTLS_POLY1305_C=n
CONFIG_MBEDTLS_SHA1_C=n
CONFIG_MBEDTLS_DHM_C=n
CONFIG_MBEDTLS_CMAC_C=n
CONFIG_MBEDTLS_CIPHER_MODE_CTR=n
CONFIG_MBEDTLS_CIPHER_MODE_CFB=n
CONFIG_MBEDTLS_CIPHER_MODE_OFB=n
CONFIG_MBEDTLS_KEY_EXCHANGE_DHE_PSK_ENABLED=n
CONFIG_MBEDTLS_KEY_EXCHANGE_DHE_RSA_ENABLED=n
#Cipher Suite enable
CONFIG_MBEDTLS_CIPHER=y
CONFIG_MBEDTLS_KEY_EXCHANGE_ECDHE_ECDSA_ENABLED=y
CONFIG_MBEDTLS_KEY_EXCHANGE_ECDHE_RSA_ENABLED=y
CONFIG_MBEDTLS_KEY_EXCHANGE_ECDH_RSA_ENABLED=y
CONFIG_PSA_WANT_ECC_SECP_R1_256=y
CONFIG_PSA_WANT_ALG_ECDH=n
CONFIG_PSA_WANT_ALG_ECDSA=n
CONFIG_PSA_WANT_ALG_DETERMINISTIC_ECDSA=n
CONFIG_MBEDTLS_ECDSA_DETERMINISTIC=y
CONFIG_MBEDTLS_ECP_C=y
CONFIG_MBEDTLS_SHA512_C=y
CONFIG_MBEDTLS_ECDH_C=y
CONFIG_MBEDTLS_SSL_SRV_C=y
CONFIG_MBEDTLS_AES_C=y
CONFIG_MBEDTLS_CCM_C=y
CONFIG_MBEDTLS_PKCS1_V15=y
CONFIG_MBEDTLS_ECDSA_C=y
CONFIG_MBEDTLS_GCM_C=y
CONFIG_MBEDTLS_SHA256_C=y
CONFIG_MBEDTLS_X509_LIBRARY=y
```

## boards/C91S_ns.conf
```kconfig
#
# Copyright (c) 2024 Nordic Semiconductor ASA
#
# SPDX-License-Identifier: LicenseRef-Nordic-5-Clause
#

# Configuration file for nRF9151 DK
# This file is merged with prj.conf in the application folder, and options
# set here will take precedence if they are present in both files.

# General
CONFIG_HW_STACK_PROTECTION=y
CONFIG_HW_ID_LIBRARY_SOURCE_IMEI=y
#CONFIG_PICOLIBC=y
CONFIG_NEWLIB_LIBC=y
CONFIG_NEWLIB_LIBC_FLOAT_PRINTF=y

# Modem related configurations
CONFIG_MODEM_INFO=y
CONFIG_AT_HOST_LIBRARY=y

# Modem trace
CONFIG_NRF_MODEM_LIB_TRACE=n
CONFIG_NRF_MODEM_LIB_TRACE_BACKEND_UART=n
CONFIG_SERIAL=y
CONFIG_UART_ASYNC_API=y
CONFIG_UART_1_ASYNC=y
CONFIG_UART_1_INTERRUPT_DRIVEN=y
CONFIG_UART_INTERRUPT_DRIVEN=y

# Disable Duplicate Address Detection (DAD)
# due to not being properly implemented for offloaded interfaces.
CONFIG_NET_IPV6_NBR_CACHE=n
CONFIG_NET_IPV6_MLD=n

# Zephyr NET Connection Manager and Connectivity layer.
CONFIG_NET_CONNECTION_MANAGER_MONITOR_STACK_SIZE=1024
CONFIG_NRF_MODEM_LIB_NET_IF=y

# Bootloader and FOTA related configurations

# MCUBOOT
CONFIG_BOOTLOADER_MCUBOOT=y
CONFIG_MCUBOOT_IMG_MANAGER=y

# Image manager
CONFIG_IMG_MANAGER=y
CONFIG_STREAM_FLASH=y
CONFIG_FLASH_MAP=y
CONFIG_FLASH=y
CONFIG_IMG_ERASE_PROGRESSIVELY=y

# AWS FOTA
CONFIG_AWS_FOTA=y
CONFIG_FOTA_DOWNLOAD=y
CONFIG_DFU_TARGET=y

# Download client (needed by AWS FOTA)
CONFIG_DOWNLOAD_CLIENT=y
CONFIG_DOWNLOAD_CLIENT_STACK_SIZE=4096


CONFIG_LOG=y
CONFIG_LOG_CMDS=y
CONFIG_GPIO=y
CONFIG_REGULATOR=y
CONFIG_SENSOR=y
CONFIG_NRF_FUEL_GAUGE=y
CONFIG_REQUIRES_FLOAT_PRINTF=y
```

## boards/nrf9151dk_nrf9151_ns.conf
```kconfig
#
# Copyright (c) 2024 Nordic Semiconductor ASA
#
# SPDX-License-Identifier: LicenseRef-Nordic-5-Clause
#

# Configuration file for nRF9151 DK
# This file is merged with prj.conf in the application folder, and options
# set here will take precedence if they are present in both files.

# General
CONFIG_HW_STACK_PROTECTION=y
CONFIG_HW_ID_LIBRARY_SOURCE_IMEI=y
#CONFIG_PICOLIBC=y
CONFIG_NEWLIB_LIBC=y
CONFIG_NEWLIB_LIBC_FLOAT_PRINTF=y

# Modem related configurations
CONFIG_MODEM_INFO=y
CONFIG_AT_HOST_LIBRARY=y

# Modem trace
CONFIG_NRF_MODEM_LIB_TRACE=n
CONFIG_NRF_MODEM_LIB_TRACE_BACKEND_UART=n
CONFIG_SERIAL=y
CONFIG_UART_ASYNC_API=y
CONFIG_UART_1_ASYNC=y
CONFIG_UART_1_INTERRUPT_DRIVEN=y
CONFIG_UART_INTERRUPT_DRIVEN=y

# Disable Duplicate Address Detection (DAD)
# due to not being properly implemented for offloaded interfaces.
CONFIG_NET_IPV6_NBR_CACHE=n
CONFIG_NET_IPV6_MLD=n

# Zephyr NET Connection Manager and Connectivity layer.
CONFIG_NET_CONNECTION_MANAGER_MONITOR_STACK_SIZE=1024
CONFIG_NRF_MODEM_LIB_NET_IF=y

# Bootloader and FOTA related configurations

# MCUBOOT
CONFIG_BOOTLOADER_MCUBOOT=y
CONFIG_MCUBOOT_IMG_MANAGER=y

# Image manager
CONFIG_IMG_MANAGER=y
CONFIG_STREAM_FLASH=y
CONFIG_FLASH_MAP=y
CONFIG_FLASH=y
CONFIG_IMG_ERASE_PROGRESSIVELY=y

# AWS FOTA
CONFIG_AWS_FOTA=y
CONFIG_FOTA_DOWNLOAD=y
CONFIG_DFU_TARGET=y

# Download client (needed by AWS FOTA)
CONFIG_DOWNLOAD_CLIENT=y
CONFIG_DOWNLOAD_CLIENT_STACK_SIZE=4096
```

## boards/nrf9160dk_nrf9160_ns.conf
```kconfig
#
# Copyright (c) 2024 Nordic Semiconductor ASA
#
# SPDX-License-Identifier: LicenseRef-Nordic-5-Clause
#

# Configuration file for nRF9151 DK
# This file is merged with prj.conf in the application folder, and options
# set here will take precedence if they are present in both files.

# General
CONFIG_HW_STACK_PROTECTION=y
CONFIG_HW_ID_LIBRARY_SOURCE_IMEI=y
#CONFIG_PICOLIBC=y
#CONFIG_PICOLIBC_IO_FLOAT=y
#CONFIG_PICOLIBC_IO_FLOAT_PRINTF=y
CONFIG_NEWLIB_LIBC=y
CONFIG_NEWLIB_LIBC_FLOAT_PRINTF=y

# Modem related configurations
CONFIG_MODEM_INFO=y
CONFIG_AT_HOST_LIBRARY=y

# Modem trace
CONFIG_NRF_MODEM_LIB_TRACE=n
CONFIG_NRF_MODEM_LIB_TRACE_BACKEND_UART=n
CONFIG_SERIAL=y
CONFIG_UART_ASYNC_API=y
CONFIG_UART_1_ASYNC=y
CONFIG_UART_1_INTERRUPT_DRIVEN=y
CONFIG_UART_INTERRUPT_DRIVEN=y
CONFIG_UART_CONSOLE=y

# Disable Duplicate Address Detection (DAD)
# due to not being properly implemented for offloaded interfaces.
CONFIG_NET_IPV6_NBR_CACHE=n
CONFIG_NET_IPV6_MLD=n

# Zephyr NET Connection Manager and Connectivity layer.
CONFIG_NET_CONNECTION_MANAGER_MONITOR_STACK_SIZE=1024
CONFIG_NRF_MODEM_LIB_NET_IF=y

# Bootloader and FOTA related configurations

# MCUBOOT
CONFIG_BOOTLOADER_MCUBOOT=y
CONFIG_MCUBOOT_IMG_MANAGER=y

# Image manager
CONFIG_IMG_MANAGER=y
CONFIG_STREAM_FLASH=y
CONFIG_FLASH_MAP=y
CONFIG_FLASH=y
CONFIG_IMG_ERASE_PROGRESSIVELY=y

# AWS FOTA
CONFIG_AWS_FOTA=y
CONFIG_FOTA_DOWNLOAD=y
CONFIG_DFU_TARGET=y

# Download client (needed by AWS FOTA)
CONFIG_DOWNLOAD_CLIENT=y
CONFIG_DOWNLOAD_CLIENT_STACK_SIZE=4096
#CONFIG_MCUBOOT=y
```

## boards/C91S_nrf9151_ns.overlay
```dts
// To get started, press Ctrl+Space to bring up the completion menu and view the available nodes.

// You can also use the buttons in the sidebar to perform actions on nodes.
// Actions currently available include:

// * Enabling / disabling the node
// * Adding the bus to a bus
// * Removing the node
// * Connecting ADC channels

// For more help, browse the DeviceTree documentation at https://docs.zephyrproject.org/latest/guides/dts/index.html
// You can also visit the nRF DeviceTree extension documentation at https://docs.nordicsemi.com/bundle/nrf-connect-vscode/page/guides/ncs_configure_app.html#devicetree-support-in-the-extension


externalsensor: &uart1 {
	current-speed = <115200>;
	status = "okay";
    pinctrl-0 = <&uart1_default>;
    pinctrl-1 = <&uart1_sleep>;
    pinctrl-names = "default", "sleep";
};

&wdt {
	status = "okay";
};

//&systick {
//    status = "okay";
//};

//&clock {
 //   status = "okay";
//};

//&kmu {
 //   status = "disabled";
//};

//&power {
 //   status = "disabled";
//};
```

## boards/nrf9151dk_nrf9151_ns.overlay
```dts
/*
 * Copyright (c) 2024 Nordic Semiconductor ASA
 *
 * SPDX-License-Identifier: LicenseRef-Nordic-5-Clause
 */

/* Enable uart1 for tracing. */

externalsensor: &uart1 {
	current-speed = <115200>;
	status = "okay";
};
```

## boards/nrf9160dk_nrf9160_ns.overlay
```dts
/*
 * Copyright (c) 2023 Nordic Semiconductor ASA
 *
 * SPDX-License-Identifier: LicenseRef-Nordic-5-Clause
 */

/* Enable uart1 for tracing. */

externalsensor: &uart1 {
	current-speed = <115200>;
	status = "okay";
	/*hw-flow-control;*/
};
```

## src/main.c
```c
/*
 * Copyright (c) 2025 CORE Labs
 */
#include "shadow_payload.h"
#include <hw_id.h>
#include <modem/lte_lc.h>
#include <modem/modem_info.h>
#include <modem/modem_key_mgmt.h>
#include <net/aws_iot.h>
#include <stdio.h>
#include <stdlib.h>
#include <string.h>
#include <zephyr/dfu/mcuboot.h>
#include <zephyr/drivers/uart.h>
#include <zephyr/kernel.h>
#include <zephyr/logging/log.h>
#include <zephyr/logging/log_ctrl.h>
#include <zephyr/net/conn_mgr_connectivity.h>
#include <zephyr/net/conn_mgr_monitor.h>
#include <zephyr/sys/reboot.h>
#include <hal/nrf_power.h>
#include "connectivity_interface.h"
#include "fleet_provisioning.h"
#include "mqtt_pub_sub.h"
#include "nvs_flash.h"
#include "watchdog_app.h"

/* Register log module */
LOG_MODULE_REGISTER(aws_iot_sample, CONFIG_AWS_IOT_SAMPLE_LOG_LEVEL);
struct provison_setting prov_set = {.device_provisioned = 0,
                                    .rotate_cert = 0,
                                    .sec_tag = CONFIG_MQTT_HELPER_SEC_TAG,
                                    .old_sec_tag = 0,
                                    .thing_name = "",
                                    .verify_connectivity = 0};

struct Sys_info sys_info = {
    .last_reboot_reason = "NONE",  
    .add_reset_reason = true
};                               
static char hw_id[HW_ID_LEN];
#define MAX_UART_MSG_SIZE 256
/* Forward declarations. */
#define UART_DEVICE_NODE DT_NODELABEL(externalsensor)
static const struct device *uart_dev = DEVICE_DT_GET(UART_DEVICE_NODE);
static char rx_buffer[MAX_UART_MSG_SIZE];
static int rx_index = 0;
K_MSGQ_DEFINE(uart_msgq, MAX_UART_MSG_SIZE, 2, 4);
void uart_send(const char *msg) {
  for (int i = 0; msg[i] != '\0'; i++) {
    uart_poll_out(uart_dev, msg[i]); // Send character
  }
}
// UART Interrupt Callback
void uart_callback(const struct device *dev, void *user_data) {
  uint8_t c;
  while (uart_fifo_read(dev, &c, 1) > 0) {
    if (c == '\n' || rx_index >= MAX_UART_MSG_SIZE- 1) {
      rx_buffer[rx_index] = '\0';
      printk("Recived data on RX channel: %s\n", rx_buffer);
      k_msgq_put(&uart_msgq, &rx_buffer, K_NO_WAIT);
      rx_index = 0;
    } else {
      rx_buffer[rx_index++] = c;
    }
  }
}

int convert_to_unformatted(cJSON **json, char *formatted_json,
                           char **unformatted_json) {
  *json = cJSON_Parse(formatted_json);
  if (*json == NULL) {
    printf("Error parsing JSON: %s\n", cJSON_GetErrorPtr());
    return 1;
  }

  *unformatted_json = cJSON_PrintUnformatted(*json);
  if (*unformatted_json) {
    //printf("Unformatted JSON: %s\n", *unformatted_json);
    return 0;
  }
  return 1;
}
void uart_init() {
  if (!device_is_ready(uart_dev)) {
    printk("UART1 not ready\n");
    return;
  }
  uart_irq_callback_user_data_set(uart_dev, uart_callback, NULL);
  uart_irq_rx_enable(uart_dev);
  printk("UART1 initialized\n");
}
//char reset_reason[50] = "NONE";
static void log_resetreason(uint32_t rr)
{
        /* Reset reason */
        LOG_DBG("Reset reasons:\n");
        if (0 == rr)
        {
                LOG_DBG("- NONE\n");
                strcpy(sys_info.last_reboot_reason, "NONE");
        }
        else if (0 != (rr & NRF_POWER_RESETREAS_RESETPIN_MASK))
        {
                LOG_DBG("- RESETPIN\n");
                strcpy(sys_info.last_reboot_reason, "RESETPIN");
        }
        else if (0 != (rr & NRF_POWER_RESETREAS_DOG_MASK))
        {
                LOG_DBG("- Watch DOG\n");
                strcpy(sys_info.last_reboot_reason, "Watch DOG");
        }
        else if (0 != (rr & NRF_POWER_RESETREAS_SREQ_MASK))
        {
                LOG_DBG("- SREQ\n");
                strcpy(sys_info.last_reboot_reason, "SREQ");
        }
        else if (0 != (rr & NRF_POWER_RESETREAS_LOCKUP_MASK))
        {
                LOG_DBG("- LOCKUP\n");
                strcpy(sys_info.last_reboot_reason, "LOCKUP");
        }
        else if (0 != (rr & NRF_POWER_RESETREAS_OFF_MASK))
        {
                LOG_DBG("- OFF\n");
                strcpy(sys_info.last_reboot_reason, "OFF");
        }

        else if (0 != (rr & NRF_POWER_RESETREAS_DIF_MASK))
        {
                LOG_DBG("- DIF\n");
                strcpy(sys_info.last_reboot_reason, "DIF");
        }
}
int main(void) {
  LOG_INF("Fleet Provisioning over Cellular, version: %s",
          CONFIG_AWS_IOT_SAMPLE_APP_VERSION);



    int rr = nrf_power_resetreas_get(NRF_POWER);
        printk("RESETREAS: 0x%08x\n", rr);
        log_resetreason(rr);
        printk("reset reason:%s\n",sys_info.last_reboot_reason);   
          if (IS_ENABLED(CONFIG_WATCHDOG))
        {
                if (watchdog_init_and_start() == 0)
                {
                        LOG_INF("WATCH DOG  init and Start");
                }
                else
                        LOG_INF("Failed to init and Start WATCH DOG");
        }
  int err;
  err = init_nvs_sys();
  if (err == 0) {
    printk("NVS init successfully \n");
  }
  // write_provision_status_to_nvs();
  err = read_from_nvs(KEY_ID_PROVISION_STATUS, &prov_set.device_provisioned);
  if (err == 0) { // prov_set.device_provisioned=0;
    if (prov_set.device_provisioned == 1) {
      prov_set.sec_tag = CONFIG_MQTT_HELPER_SEC_TAG + 1;
      printk("Device already provisioned \n");
    }
  } else {
    printk("Failed to read provision status from NVS %d\n", err);
  }
  err = read_from_nvs(KEY_ID_SEC_TAG, &prov_set.sec_tag);
  if (err == 0) {
    printk("Successfully read sec tag %d\n", prov_set.sec_tag);
  } else {
    printk("Failed to read sec tag from NVS %d\n", err);
  }
  err = read_from_nvs(KEY_CERT_ROTATION, &prov_set.rotate_cert);
  if (err == 0) {
    printk("Successfully read CERT ROTATION FLAG from NVS %d\n",
           prov_set.rotate_cert);
  } else {
    printk("Failed to read CERT ROTATION from NVS %d\n", err);
  }
  uart_init();/* initialized uart 1 for external sensor*/

  /* Setup handler for Zephyr NET Connection Manager events. */
  net_mgmt_init_event_callback(&l4_cb, l4_event_handler, L4_EVENT_MASK);
  net_mgmt_add_event_callback(&l4_cb);

  /* Setup handler for Zephyr NET Connection Manager Connectivity layer. */
  net_mgmt_init_event_callback(&conn_cb, connectivity_event_handler,
                               CONN_LAYER_EVENT_MASK);
  net_mgmt_add_event_callback(&conn_cb);

  /* Connecting to the configured connectivity layer.
   * Wi-Fi or LTE depending on the board that the sample was built for.
   */
  LOG_INF("Bringing network interface up and connecting to the network");

  err = conn_mgr_all_if_up(true);
  if (err) {
    LOG_ERR("conn_mgr_all_if_up, error: %d", err);
    FATAL_ERROR();
    return err;
  }

  err = conn_mgr_all_if_connect(true);
  if (err) {
    LOG_ERR("conn_mgr_all_if_connect, error: %d", err);
    FATAL_ERROR();
    return err;
  }

#if defined(CONFIG_AWS_IOT_SAMPLE_DEVICE_ID_USE_HW_ID)
  /* Get unique hardware ID, can be used as AWS IoT MQTT broker device/client
   * ID. */
  err = hw_id_get(hw_id, ARRAY_SIZE(hw_id));
  if (err) {
    LOG_ERR("Failed to retrieve hardware ID, error: %d", err);
    FATAL_ERROR();
    return err;
  }
  snprintk(prov_set.thing_name, 12, "CORE_%s", &hw_id[HW_ID_LEN - 7]);
  LOG_INF("Hardware ID: %s", hw_id);
  LOG_INF("Thing name: %s", prov_set.thing_name);

#endif /* CONFIG_AWS_IOT_SAMPLE_DEVICE_ID_USE_HW_ID */

  err = aws_iot_client_init();
  if (err) {
    LOG_ERR("aws_iot_client_init, error: %d", err);
    FATAL_ERROR();
    return err;
  }

  /* Resend connection status if the sample is built for QEMU x86.
   * This is necessary because the network interface is automatically brought up
   * at SYS_INIT() before main() is called.
   * This means that NET_EVENT_L4_CONNECTED fires before the
   * appropriate handler l4_event_handler() is registered.
   */
  if (IS_ENABLED(CONFIG_BOARD_NATIVE_SIM)) {
    conn_mgr_mon_resend_status();
  }

  return 0;
}
```

## src/connectivity_interface.c
```c
#include <zephyr/kernel.h>
#include <zephyr/sys/reboot.h>
#include <zephyr/dfu/mcuboot.h>
#include <zephyr/logging/log.h>
#include <zephyr/logging/log_ctrl.h>
#include <zephyr/net/conn_mgr_connectivity.h>
#include <zephyr/net/conn_mgr_monitor.h>
#include <net/aws_iot.h>
#include <stdio.h>
#include <stdlib.h>
#include <hw_id.h>
#include <modem/modem_info.h>
#include <modem/modem_key_mgmt.h>
#include "shadow_payload.h"
#include <modem/lte_lc.h>
#include "fleet_provisioning.h"
#include "nvs_flash.h"
#include "mqtt_pub_sub.h"
#include "connectivity_interface.h"
#if defined(CONFIG_MQTT_HELPER_PROVISION_CERTIFICATES)
#include "mqtt-certs.h"
#endif
LOG_MODULE_REGISTER(connectivity_interface,CONFIG_AWS_IOT_SAMPLE_LOG_LEVEL);
/* System Workqueue handlers. */

 void l4_event_handler(struct net_mgmt_event_callback *cb, uint32_t event,
			     struct net_if *iface)
{
	switch (event) {
	case NET_EVENT_L4_CONNECTED:
		LOG_INF("Network connectivity established");
		on_net_event_l4_connected();
		break;
	case NET_EVENT_L4_DISCONNECTED:
		LOG_INF("Network connectivity lost");
		on_net_event_l4_disconnected();
		break;
	default:
		/* Don't care */
		return;
	}
}

void connectivity_event_handler(struct net_mgmt_event_callback *cb, uint32_t event,
				       struct net_if *iface)
{
	if (event == NET_EVENT_CONN_IF_FATAL_ERROR) {
		LOG_ERR("NET_EVENT_CONN_IF_FATAL_ERROR");
		FATAL_ERROR();
		return;
	}
}
```

## src/connectivity_interface.h
```c
#ifndef CONNECT__INTERFACE__
#define CONNECT__INTERFACE__
#define L4_EVENT_MASK	      (NET_EVENT_L4_CONNECTED | NET_EVENT_L4_DISCONNECTED)
#define CONN_LAYER_EVENT_MASK (NET_EVENT_CONN_IF_FATAL_ERROR)

static struct net_mgmt_event_callback l4_cb;
static struct net_mgmt_event_callback conn_cb;
void l4_event_handler(struct net_mgmt_event_callback *cb, uint32_t event,
			     struct net_if *iface);

void connectivity_event_handler(struct net_mgmt_event_callback *cb, uint32_t event,
				       struct net_if *iface);
#endif
```

## src/fleet_provisioning.c
```c
#include <zephyr/kernel.h>
#include <zephyr/sys/reboot.h>
#include <zephyr/dfu/mcuboot.h>
#include <zephyr/logging/log.h>
#include <zephyr/logging/log_ctrl.h>
#include <zephyr/net/conn_mgr_connectivity.h>
#include <zephyr/net/conn_mgr_monitor.h>
#include <net/aws_iot.h>
#include <stdio.h>
#include <stdlib.h>
#include <hw_id.h>
#include <modem/modem_info.h>
#include <modem/modem_key_mgmt.h>
#include "shadow_payload.h"
#include <modem/lte_lc.h>
#include "fleet_provisioning.h"
#include "nvs_flash.h"
#if defined(CONFIG_MQTT_HELPER_PROVISION_CERTIFICATES)
#include "mqtt-certs.h"
#endif

#include "mqtt_pub_sub.h"

LOG_MODULE_REGISTER(fleet_provision,CONFIG_AWS_IOT_SAMPLE_LOG_LEVEL);

/* Certificate and key buffers for provisioning */
static char client_certificate_new[2048];
static size_t client_certificate_len_new;
static char private_key_new[2048];
static size_t private_key_len_new;
static char key_cert_topic[40];
static char key_cert_topic_get[75];

/* CA certificate */
static const unsigned char ca[] = {
#if defined(MQTT_HELPER_CA_CERT_1)
#include MQTT_HELPER_CA_CERT_1
    (0x00)
#else
    ""
#endif
};

static enum topic_type topic_filter(const char *topic, size_t topic_len)
{
	if (strstr(topic, KEY_TOPIC_FILTER) != NULL) {
		return KEY_TOPIC;
	} else if (strstr(topic, CERT_TOPIC_FILTER) != NULL) {
		return CERT_TOPIC;
	}

	return UNKNOWN;
}


 void assemble_credentials(const char *buf, size_t buf_len, const char *topic,
				 size_t topic_len)
{
	int err;

	LOG_INF("%d Bytes received from AWS IoT console: Topic: %.*s:", buf_len, topic_len, topic);
	//LOG_INF("\n\n%.*s", buf_len, buf);

	if (prov_set.device_provisioned && !prov_set.rotate_cert) {
		LOG_WRN("Device already provisioned");
		return;
	}

	enum topic_type type = topic_filter(topic, topic_len);

	switch (type) {
	case KEY_TOPIC:
		LOG_INF("KEY_TOPIC");
		__ASSERT_NO_MSG(sizeof(private_key_new) > buf_len);
		memcpy(&private_key_new, buf, buf_len);
		private_key_len_new = buf_len;
		LOG_INF("Private key copied");
		break;
	case CERT_TOPIC:
		LOG_INF("CERT_TOPIC");
		__ASSERT_NO_MSG(sizeof(client_certificate_new) > buf_len);
		memcpy(&client_certificate_new, buf, buf_len);
		client_certificate_len_new = buf_len;
		LOG_INF("Certificate copied");
		break;
	default:
		LOG_ERR("Unknown incoming topic!");
		return;
	}

	if (client_certificate_len_new == 0 || private_key_len_new == 0) {
		LOG_INF("Not all credentials has been received, abort provisioning");
		return;
	}

	LOG_INF("Provision credentials");

	/* Disconnect client before shutting down the modem. */
	(void)aws_iot_disconnect();

	LOG_INF("AWS IoT Client disconnected");

	/* Go offline in order to provision credentials. */
	err = lte_lc_offline();
	if (err == 0) {
		LOG_INF("Modem set in offline mode");

		/* Write Private key */
		err = modem_key_mgmt_write(prov_set.sec_tag, MODEM_KEY_MGMT_CRED_TYPE_PRIVATE_CERT,
					   &private_key_new, private_key_len_new);
		if (err) {
			LOG_ERR("Failed writing private key to the modem, error: %d", err);
			lte_lc_connect();
			return;
		}
		printk("Private key written on modem successfully, size: %d\n", private_key_len_new);

		/* Write client certificate */
		err = modem_key_mgmt_write(prov_set.sec_tag, MODEM_KEY_MGMT_CRED_TYPE_PUBLIC_CERT,
					   &client_certificate_new, client_certificate_len_new);
		if (err) {
			LOG_ERR("Failed writing client certificate to the modem, error: %d", err);
			lte_lc_connect();
			return;
		}
		printk("Client certificate written on modem successfully, size: %d\n", client_certificate_len_new);

		/* Write CA certificate */
		err = modem_key_mgmt_write(prov_set.sec_tag, MODEM_KEY_MGMT_CRED_TYPE_CA_CHAIN, ca,
					   sizeof(ca));
		if (err) {
			LOG_ERR("Failed writing CA certificate to the modem, error: %d", err);
			lte_lc_connect();
			return;
		}
		printk("CA certificate written on modem successfully, size: %d\n", sizeof(ca));
		LOG_INF("Credentials written to the modem!");
		prov_set.device_provisioned = 1;
		err=write_to_nvs(KEY_ID_PROVISION_STATUS,&prov_set.device_provisioned);
		if(err!=0)
		  printk("Failed to write provision status to NVS %d ",err);
		k_msleep(3000);
		err=read_from_nvs(KEY_ID_PROVISION_STATUS,&prov_set.device_provisioned);
		if(err!=0)
		   printk("Failed to read provision status frm NVS %d ",err);
		if(prov_set.device_provisioned==1 && prov_set.rotate_cert==0)
		{printk("Rebooting system\n");
		sys_reboot(0);
		}

		/* Connect to LTE for certificate rotation verification */
		prov_set.verify_connectivity = 1;
		lte_lc_connect();
	} else

	{
		printk("Failed to put modem in offline mode \n");
	}
}


int credentials_get(void)
{
	int err = 0;
	err = snprintk(key_cert_topic_get, sizeof(key_cert_topic_get), CRED_CREATE_TOPIC,
		       prov_set.thing_name);
	if (err < 0 || err >= sizeof(key_cert_topic_get)) {
		return -ENOMEM;
	}

	/* Publish blank message to certificate/${deviceId}/create to get credentials. */
	printk("Topic to publish %s", key_cert_topic_get);
	struct aws_iot_data tx_data = {.qos = MQTT_QOS_1_AT_LEAST_ONCE,
				       .topic.type = AWS_IOT_SHADOW_TOPIC_NONE,
				       .topic.str = key_cert_topic_get,
				       .topic.len = strlen(key_cert_topic_get),
				       .ptr = "",
				       .len = strlen("")};

	LOG_INF("Publishing blank message to AWS IoT broker");

	err = aws_iot_send(&tx_data);
	if (err) {
		LOG_INF("aws_iot_send, error: %d", err);
		return err;
	}

	return 0;
}
```

## src/fleet_provisioning.h
```c
#ifndef FLEET_PROV__
#define FLEET_PROV__

#define FATAL_ERROR()                                                          \
  LOG_ERR("Fatal error! Rebooting the device.");                               \
  LOG_PANIC();                                                                 \
  IF_ENABLED(CONFIG_REBOOT, (sys_reboot(0)))
struct provison_setting {
  uint8_t device_provisioned;
  uint8_t rotate_cert;
  uint8_t sec_tag;
  uint8_t verify_connectivity;
  uint8_t old_sec_tag;
  char thing_name[12];
};

struct Sys_info{
char last_reboot_reason[30];
bool add_reset_reason;

};

#define KEY_TOPIC_FILTER "key"
#define WILD_CARD "+"
#define CERT_TOPIC_FILTER "cert"
#define CRED_TOPIC "certificates/"
#define CRED_TOPIC_LEN (sizeof(CRED_TOPIC))
#define CRED_CREATE_TOPIC "%s/create"
#define CRED_CREATE_TOPIC_LEN                                                  \
  (CRED_TOPIC_LEN + CONFIG_AWS_IOT_CLIENT_ID_MAX_LEN + 11)

#define CRED_GET_TOPIC "/create/accepted/"
#define GET_TOPIC_LEN (CRED_TOPIC_LEN + CONFIG_AWS_IOT_CLIENT_ID_MAX_LEN + 11)
extern struct provison_setting prov_set;
extern struct Sys_info sys_info;
int credentials_get(void);
void assemble_credentials(const char *buf, size_t buf_len, const char *topic,
                          size_t topic_len);

enum topic_type { KEY_TOPIC, CERT_TOPIC, UNKNOWN };
#endif
```

## src/mqtt_pub_sub.c
```c
#include <zephyr/kernel.h>
#include <zephyr/sys/reboot.h>
#include <zephyr/dfu/mcuboot.h>
#include <zephyr/logging/log.h>
#include <zephyr/logging/log_ctrl.h>
#include <zephyr/net/conn_mgr_connectivity.h>
#include <zephyr/net/conn_mgr_monitor.h>
#include <net/aws_iot.h>
#include <stdio.h>
#include <stdlib.h>
#include <hw_id.h>
#include <cJSON.h>
#include <modem/modem_info.h>
#include <modem/modem_key_mgmt.h>
#include "shadow_payload.h"
#include <modem/lte_lc.h>
#include "fleet_provisioning.h"
#include "nvs_flash.h"
#include "mqtt_pub_sub.h"
#if defined(CONFIG_MQTT_HELPER_PROVISION_CERTIFICATES)
#include "mqtt-certs.h"
#endif

LOG_MODULE_REGISTER(mqtt_pub_sub, CONFIG_AWS_IOT_SAMPLE_LOG_LEVEL);
/* Work items used to control some aspects of the sample. */
static K_WORK_DELAYABLE_DEFINE(shadow_update_work, shadow_update_work_fn);
static K_WORK_DELAYABLE_DEFINE(connect_work, connect_work_fn);
static char config_set_topic[32];
static char config_get_topic[32];
static char data_from_cloud_topic[32];
static char data_to_cloud_topic[64];
static char cred_topic[40];
static struct mqtt_topic topic_list[3];
extern struct k_msgq uart_msgq;
void uart_send(const char *msg);
bool add_reset_reason = true;
int convert_to_unformatted(
    cJSON **json, char *formatted_json,
    char **unformatted_json);

int app_topics_subscribe(void) {
  int err;
  snprintf(config_get_topic, sizeof(config_get_topic), "%s%s",
           prov_set.thing_name, CONFIG_GET_TOPIC);
  snprintf(config_set_topic, sizeof(config_set_topic), "%s%s",
           prov_set.thing_name, CONFIG_SET_TOPIC);
  snprintf(data_from_cloud_topic, sizeof(data_from_cloud_topic), "%s%s",
           prov_set.thing_name, DATA_FROM_CLOUD_TOPIC);
  int len = snprintf(data_to_cloud_topic, sizeof(data_to_cloud_topic), "%s%s",
                     prov_set.thing_name, DATA_TO_CLOUD_TOPIC);
  if (len >= sizeof(data_to_cloud_topic)) {
    printk("Warning: topic truncated!\n");
  }
  snprintf(config_set_topic, sizeof(config_set_topic), "%s%s",
           prov_set.thing_name, CONFIG_SET_TOPIC);
  uint8_t count = 0;
  snprintf(cred_topic, sizeof(cred_topic), "%s%s%s", prov_set.thing_name,
           CRED_GET_TOPIC, WILD_CARD);
  topic_list[count].topic.utf8 = cred_topic;
  topic_list[count].topic.size = strlen(cred_topic);
  topic_list[count].qos = MQTT_QOS_1_AT_LEAST_ONCE;

  printk("topic list %d entry %s\n", count + 1, topic_list[count].topic.utf8);
  printk("topic list %d entry size %d\n", count + 1,
         topic_list[count].topic.size);
  count++;

  topic_list[count].topic.utf8 = config_set_topic;
  topic_list[count].topic.size = strlen(config_set_topic);
  topic_list[count].qos = MQTT_QOS_0_AT_MOST_ONCE;

  printk("topic list %d entry %s\n", count + 1, topic_list[count].topic.utf8);
  printk("topic list %d entry size %d\n", count + 1,
         topic_list[count].topic.size);

  count++;
  topic_list[count].topic.utf8 = data_from_cloud_topic;
  topic_list[count].topic.size = strlen(data_from_cloud_topic);
  topic_list[count].qos = MQTT_QOS_1_AT_LEAST_ONCE;
  printk("topic list %d entry %s\n", count + 1, topic_list[count].topic.utf8);
  printk("topic list %d entry size %d\n", count + 1,
         topic_list[count].topic.size);

  err = aws_iot_application_topics_set(topic_list,
                                       count + 1); // ARRAY_SIZE(topic_list));
  if (err) {
    LOG_ERR("aws_iot_application_topics_set, error: %d", err);
    FATAL_ERROR();
    return err;
  }

  return 0;
}

static int json_add_obj(cJSON *parent, const char *str, cJSON *item)
{
	cJSON_AddItemToObject(parent, str, item);

	return 0;
}

static int json_add_str(cJSON *parent, const char *str, const char *item)
{
	cJSON *json_str;

	json_str = cJSON_CreateString(item);
	if (json_str == NULL)
	{
		return -ENOMEM;
	}

	return json_add_obj(parent, str, json_str);
}

static int json_add_number(cJSON *parent, const char *str, double item)
{
	cJSON *json_num;

	json_num = cJSON_CreateNumber(item);
	if (json_num == NULL)
	{
		return -ENOMEM;
	}

	return json_add_obj(parent, str, json_num);
}
int aws_iot_client_init(void)
{
	int err;

	err = aws_iot_init(aws_iot_event_handler);
	if (err)
	{
		LOG_ERR("AWS IoT library could not be initialized, error: %d", err);
		FATAL_ERROR();
		return err;
	}

	/* Add application specific non-shadow topics to the AWS IoT library.
	 * These topics will be subscribed to when connecting to the broker.
	 */
	// if (prov_set.device_provisioned == 0)

	//{
	err = app_topics_subscribe();
	if (err)
	{
		LOG_ERR("Adding application specific topics failed, error: %d", err);
		FATAL_ERROR();
		return err;
	}
        printk("topic config %s\n", config_get_topic);
        printk("topic config set %s\n", config_set_topic);
        printk("topic data from cloud %s\n", data_from_cloud_topic);
        printk("topic data to cloud %s\n", data_to_cloud_topic);
        return 0;
}

void mqtttopic_handler(const struct aws_iot_evt *const evt)

{
	int8_t err = 0;
	if (strncmp(evt->data.msg.topic.str, config_set_topic, strlen(config_set_topic)) == 0)
	{
		//printk("incoming message %s\n", evt->data.msg.ptr);
		LOG_INF("Incoming Message: \"%.*s\" on topic: \"%.*s\"", evt->data.msg.len,
				   evt->data.msg.ptr, evt->data.msg.topic.len, evt->data.msg.topic.str);
		cJSON *json = cJSON_Parse(evt->data.msg.ptr);
		if (json == NULL)
		{
			const char *error_ptr = cJSON_GetErrorPtr();
			if (error_ptr != NULL)
			{
				printf("Error: %s\n", error_ptr);
			}
			return;
		}
		cJSON *rotate_cert = cJSON_GetObjectItemCaseSensitive(json, "rotate_cert");
		if (rotate_cert != NULL && cJSON_IsNumber(rotate_cert))
		{
			printf("rotate_cert: %d\n", rotate_cert->valueint);
		}
		cJSON *sec_tag = cJSON_GetObjectItemCaseSensitive(json, "sec_tag");
		if (sec_tag != NULL && cJSON_IsNumber(sec_tag))
		{
			printf("sec_tag: %d\n", sec_tag->valueint);
		}
		if (rotate_cert != NULL && sec_tag != NULL)
		{
			prov_set.rotate_cert = rotate_cert->valueint;
			prov_set.old_sec_tag = prov_set.sec_tag;
			prov_set.sec_tag = sec_tag->valueint;
		}
		printk("rotate_cert status %d, new sec tag %d,old secTag %d\n", prov_set.rotate_cert, prov_set.sec_tag, prov_set.old_sec_tag);
		cJSON_Delete(json);
	}

	if (strstr(evt->data.msg.topic.str, CRED_GET_TOPIC) != NULL)
	{
		printk("Received message after changes: len of message %d:", evt->data.msg.len);

		if (prov_set.device_provisioned == 0 || prov_set.rotate_cert == 1 || prov_set.rotate_cert == 2)
		{
			assemble_credentials(evt->data.msg.ptr, evt->data.msg.len,
								 evt->data.msg.topic.str, evt->data.msg.topic.len);
			if (prov_set.device_provisioned == 0)
			{
				prov_set.sec_tag = CONFIG_MQTT_HELPER_SEC_TAG + 1; // device is come from factory reset will use deafult +1 sec tag
			}
			err = write_to_nvs(KEY_ID_SEC_TAG, &prov_set.sec_tag);
			if (err != 0)
			{
				printk("Failed to write sec tag NVS");
			}
			
		}
	}
}
void publish(char *topic, u_int8_t type, uint8_t qos)
{
	int err = 0;
	cJSON *json = cJSON_CreateObject();

	if (json == NULL)
	{
		LOG_ERR("Failed to create JSON object");
		return;
	}
	printk("reset reason %s\n", sys_info.last_reboot_reason);
	if (prov_set.rotate_cert == 1)
		cJSON_AddStringToObject(json, "cert_rotation", "start");
	if (prov_set.rotate_cert == 2)
		cJSON_AddStringToObject(json, "cert_rotation", "inprogress");
	if (prov_set.rotate_cert == 3)
		cJSON_AddStringToObject(json, "cert_rotation", "completed");
    if(sys_info.add_reset_reason)
	   	cJSON_AddStringToObject(json, "reset_reason", sys_info.last_reboot_reason);
			//add_reset_reason = 0;
		

	char *json_str = cJSON_Print(json);

	printk("json str %s\n", json_str);
	printk("topic to publish %s", topic);
	struct aws_iot_data tx_data = {.qos = qos,
								   .topic.type = type,
								   .topic.str = topic,
								   .topic.len = strlen(topic),
								   .ptr = json_str,
								   .len = strlen(json_str)};

	LOG_INF("Publishing to AWS IoT broker on %s", topic);

	err = aws_iot_send(&tx_data);
	if (err)
	{
		LOG_INF("aws_iot_send, error: %d", err);
	}
	cJSON_free(json_str);
	cJSON_Delete(json);
	// shadow_update(false);
}
struct get_config
{
	uint8_t rotate_cert;
} get_conf;
char tx_buf[256];

int validate_json(char *json_str) {
  cJSON *json = cJSON_Parse(json_str);
  if (json == NULL) {
    printf("Error parsing JSON: %s\n", cJSON_GetErrorPtr());
    return -1;
  }
  cJSON_Delete(json);
  return 0;
}


void shadow_update_work_fn(struct k_work *work)
{
	
	int err;

	if (prov_set.device_provisioned)
	{
		char message[CONFIG_AWS_IOT_SAMPLE_JSON_MESSAGE_SIZE_MAX] = {0};
		struct payload payload = {
			.state.reported.uptime = k_uptime_get(),
			.state.reported.app_version = CONFIG_AWS_IOT_SAMPLE_APP_VERSION,
			
		};
		struct aws_iot_data tx_data = {
			.qos = MQTT_QOS_0_AT_MOST_ONCE,
			.topic.type = AWS_IOT_SHADOW_TOPIC_UPDATE,
		};

		if (IS_ENABLED(CONFIG_MODEM_INFO))
		{
			char modem_version_temp[MODEM_FIRMWARE_VERSION_SIZE_MAX];

			err = modem_info_get_fw_version(modem_version_temp,
											ARRAY_SIZE(modem_version_temp));
			if (err)
			{
				LOG_ERR("modem_info_get_fw_version, error: %d", err);
				//FATAL_ERROR();
				return;
			}

			payload.state.reported.modem_version = modem_version_temp;
			
		}

		err = json_payload_construct(message, sizeof(message), &payload);
		if (err)
		{
			LOG_ERR("json_payload_construct, error: %d", err);
			FATAL_ERROR();
			return;
		}

		tx_data.ptr = message;
		tx_data.len = strlen(message);

		LOG_INF("Publishing message: %s to AWS IoT shadow", message);
        err = aws_iot_send(&tx_data);
		if (err)
		{
			LOG_ERR("aws_iot_send, error: %d", err);
			FATAL_ERROR();
			return;
		}


                if (k_msgq_get(&uart_msgq, &tx_buf, K_SECONDS(1)) == 0) {
                if (validate_json(tx_buf) == 0) {


				 cJSON *json;
				 char *unformatted_json = NULL;
				 printk("VALID json string %s\n", tx_buf);
				 if (convert_to_unformatted(&json,tx_buf,&unformatted_json) == 0) {

				  tx_data.ptr =unformatted_json;
                  tx_data.len = strlen(unformatted_json);
				//  printk("unformatted json %s\n", unformatted_json);
				 // printk("unformatted json length %d\n", strlen(unformatted_json));
				  tx_data.topic.str = data_to_cloud_topic;
				  tx_data.topic.len = strlen(data_to_cloud_topic);
                  tx_data.topic.type = AWS_IOT_SHADOW_TOPIC_NONE;


                  LOG_INF("Publishing message: %s to AWS "
                                              "to Topic: %s", tx_data.ptr,tx_data.topic.str);



                  err = aws_iot_send(&tx_data);
                                  if (err) {
                                    LOG_ERR("aws_iot_send, error: %d", err);
                                    // FATAL_ERROR();
									cJSON_Delete(json);
									cJSON_free(unformatted_json);
                                  return;
                                 }

					cJSON_Delete(json);
					cJSON_free(unformatted_json);
                             }

							}
					else{

						printk("Invalid JSON received from UART\n");
					}

						}


        }
	if (prov_set.device_provisioned == 0)
	{
		credentials_get();
	}
	
	if (prov_set.rotate_cert > 0  || sys_info.add_reset_reason)
	{

		publish(config_get_topic, AWS_IOT_SHADOW_TOPIC_NONE, MQTT_QOS_1_AT_LEAST_ONCE);
		sys_info.add_reset_reason = false;
		if (prov_set.sec_tag == 3)
		{

			// publish(config_get_topic,AWS_IOT_SHADOW_TOPIC_NONE,MQTT_QOS_1_AT_LEAST_ONCE);
		}
		if (prov_set.rotate_cert == 1)
			prov_set.rotate_cert = 2;
	}
       // uart_send("Publishing to AWS IoT broker from nrf9151\n");
       // uart_send("\n");
        (void)k_work_reschedule(&shadow_update_work,
							K_SECONDS(CONFIG_AWS_IOT_SAMPLE_PUBLICATION_INTERVAL_SECONDS));
}

void connect_work_fn(struct k_work *work)
{
	int err;
	const struct aws_iot_config config = {
		.client_id = prov_set.thing_name,
	};
	LOG_INF("Connecting to AWS IoT with client id %s", prov_set.thing_name);
	// LOG_INF("Connecting to AWS IoT with client id %s",config.client_id);

	err = aws_iot_connect(&config);
	if (err == -EAGAIN)
	{
		LOG_INF("Connection attempt timed out, "
				"Next connection retry in %d seconds",
				CONFIG_AWS_IOT_SAMPLE_CONNECTION_RETRY_TIMEOUT_SECONDS);

		(void)k_work_reschedule(
			&connect_work,
			K_SECONDS(CONFIG_AWS_IOT_SAMPLE_CONNECTION_RETRY_TIMEOUT_SECONDS));
	}
	else if (err)
	{
		LOG_ERR("aws_iot_connect, error: %d", err);
                (void)k_work_reschedule(
                    &connect_work,
                    K_SECONDS(
                        CONFIG_AWS_IOT_SAMPLE_CONNECTION_RETRY_TIMEOUT_SECONDS));
                //FATAL_ERROR();
	}
}

/* Functions that are executed on specific connection-related events. */

void on_aws_iot_evt_connected(const struct aws_iot_evt *const evt)
{
	(void)k_work_cancel_delayable(&connect_work);

	/* If persistent session is enabled, the AWS IoT library will not subscribe to any topics.
	 * Topics from the last session will be used.
	 */
	if (evt->data.persistent_session)
	{
		LOG_INF("Persistent session is enabled, using subscriptions "
				"from the previous session");
	}

	/* Mark image as working to avoid reverting to the former image after a reboot. */
#if defined(CONFIG_BOOTLOADER_MCUBOOT)
	boot_write_img_confirmed();
#endif

	/* Start sequential updates to AWS IoT. */
	(void)k_work_reschedule(&shadow_update_work, K_NO_WAIT);
}

void on_aws_iot_evt_disconnected(void)
{
	(void)k_work_cancel_delayable(&shadow_update_work);
	(void)k_work_reschedule(&connect_work, K_SECONDS(5));
}

void on_aws_iot_evt_fota_done(const struct aws_iot_evt *const evt)
{
	int err;

	/* Tear down MQTT connection. */
	(void)aws_iot_disconnect();
	(void)k_work_cancel_delayable(&connect_work);

	/* If modem FOTA has been carried out, the modem needs to be reinitialized.
	 * This is carried out by bringing the network interface down/up.
	 */
	if (evt->data.image & DFU_TARGET_IMAGE_TYPE_ANY_MODEM)
	{
		LOG_INF("Modem FOTA done, reinitializing the modem");

		err = conn_mgr_all_if_down(true);
		if (err)
		{
			LOG_ERR("conn_mgr_all_if_down, error: %d", err);
			FATAL_ERROR();
			return;
		}

		err = conn_mgr_all_if_up(true);
		if (err)
		{
			LOG_ERR("conn_mgr_all_if_up, error: %d", err);
			FATAL_ERROR();
			return;
		}

		err = conn_mgr_all_if_connect(true);
		if (err)
		{
			LOG_ERR("conn_mgr_all_if_connect, error: %d", err);
			FATAL_ERROR();
			return;
		}
	}
	else if (evt->data.image & DFU_TARGET_IMAGE_TYPE_ANY_APPLICATION)
	{
		LOG_INF("Application FOTA done, rebooting");
		IF_ENABLED(CONFIG_REBOOT, (sys_reboot(0)));
	}
	else
	{
		LOG_WRN("Unexpected FOTA image type");
	}
}

void on_net_event_l4_connected(void)
{
	(void)k_work_reschedule(&connect_work, K_SECONDS(5));
}

void on_net_event_l4_disconnected(void)
{
	(void)aws_iot_disconnect();
	(void)k_work_cancel_delayable(&connect_work);
	(void)k_work_cancel_delayable(&shadow_update_work);
}

/* Event handlers */

void aws_iot_event_handler(const struct aws_iot_evt *const evt)
{
	switch (evt->type)
	{
	case AWS_IOT_EVT_CONNECTING:
		LOG_INF("AWS_IOT_EVT_CONNECTING");
		break;
	case AWS_IOT_EVT_CONNECTED:
		LOG_INF("AWS_IOT_EVT_CONNECTED");
		if (prov_set.rotate_cert == 2 && prov_set.verify_connectivity == 1)
		{

			prov_set.rotate_cert = 3;
			publish(config_get_topic, AWS_IOT_SHADOW_TOPIC_NONE, MQTT_QOS_1_AT_LEAST_ONCE);
			k_msleep(5000);
			if (prov_set.old_sec_tag != 0 && prov_set.old_sec_tag != prov_set.sec_tag)
			{
				printk("Deleting credentials from modem with sec_tag %d\n", prov_set.old_sec_tag);
				(void)aws_iot_disconnect();

				LOG_INF("AWS IoT Client disconnected");
				int err=mqtt_helper_deinit();
				  printk("mqtt helper de_init sattus %d\n",err);

				/* Go offline in order to remove credentials. */
				 err = lte_lc_offline();
				if (err == 0)
				{
					LOG_INF("Modem set in offline mode\n");
				}
				err = modem_key_mgmt_delete(prov_set.old_sec_tag, MODEM_KEY_MGMT_CRED_TYPE_PRIVATE_CERT);
				if (err == 0)
				printk("Private key with sec tag %d deleted from Modem\n", prov_set.old_sec_tag);
				else
                    printk("Failed to delete private key with sec tag %d from Modem\n", prov_set.old_sec_tag);

				err = modem_key_mgmt_delete(prov_set.old_sec_tag, MODEM_KEY_MGMT_CRED_TYPE_PUBLIC_CERT);
				if (err == 0)
				 printk("Client certificate with sec tag %d deleted from Modem\n", prov_set.old_sec_tag);
				 else
				 printk("Failed to delete client with sec tag %d from Modem\n", prov_set.old_sec_tag);


			}
			printk("Rebooting system in 3 sec\n");
			k_msleep(3000);
			sys_reboot(0);
		}
		on_aws_iot_evt_connected(evt);
		break;
	case AWS_IOT_EVT_DISCONNECTED:
		LOG_INF("AWS_IOT_EVT_DISCONNECTED");

		on_aws_iot_evt_disconnected();
		break;
	case AWS_IOT_EVT_DATA_RECEIVED:
		LOG_INF("AWS_IOT_EVT_DATA_RECEIVED");
	    LOG_INF("Received message on topic: \"%.*s\"",evt->data.msg.topic.len,evt->data.msg.topic.str);
		if (evt->data.msg.topic.str[0] != '$')
		{
			mqtttopic_handler(evt);
		}
		if (strncmp(evt->data.msg.topic.str, data_from_cloud_topic, strlen(data_from_cloud_topic)) == 0)
		{
			LOG_INF("Received message: \"%.*s\" on topic: \"%.*s\"", evt->data.msg.len,
				evt->data.msg.ptr, evt->data.msg.topic.len, evt->data.msg.topic.str);
			if (validate_json(evt->data.msg.ptr) == 0) {
				cJSON *json;
				char *unformatted_json = NULL;
				printk("VALID json string %s\n", evt->data.msg.ptr);
				if (convert_to_unformatted(&json, evt->data.msg.ptr, &unformatted_json) == 0) {
					uart_send(unformatted_json);
					uart_send("\n");
					cJSON_free(unformatted_json);
					cJSON_Delete(json);
				} else {
					if (json) {
						cJSON_Delete(json);
					}
				}
			}
		}
		break;
	case AWS_IOT_EVT_PUBACK:
		LOG_INF("AWS_IOT_EVT_PUBACK, message ID: %d", evt->data.message_id);
		break;
	case AWS_IOT_EVT_PINGRESP:
		LOG_INF("AWS_IOT_EVT_PINGRESP");
		break;
	case AWS_IOT_EVT_FOTA_START:
		LOG_INF("AWS_IOT_EVT_FOTA_START");
		break;
	case AWS_IOT_EVT_FOTA_ERASE_PENDING:
		LOG_INF("AWS_IOT_EVT_FOTA_ERASE_PENDING");
		break;
	case AWS_IOT_EVT_FOTA_ERASE_DONE:
		LOG_INF("AWS_FOTA_EVT_ERASE_DONE");
		break;
	case AWS_IOT_EVT_FOTA_DONE:
		LOG_INF("AWS_IOT_EVT_FOTA_DONE");
		on_aws_iot_evt_fota_done(evt);
		break;
	case AWS_IOT_EVT_FOTA_DL_PROGRESS:
		LOG_INF("AWS_IOT_EVT_FOTA_DL_PROGRESS, (%d%%)", evt->data.fota_progress);
		break;
	case AWS_IOT_EVT_ERROR:
		LOG_INF("AWS_IOT_EVT_ERROR, %d", evt->data.err);
		FATAL_ERROR();
		break;
	case AWS_IOT_EVT_FOTA_ERROR:
		LOG_INF("AWS_IOT_EVT_FOTA_ERROR");
		break;
	default:
		LOG_WRN("Unknown AWS IoT event type: %d", evt->type);
		break;
	}
}
```

## src/mqtt_pub_sub.h
```c
#ifndef MQTT_PUBSUB__
#define MQTT_PUBSUB__

#define MODEM_FIRMWARE_VERSION_SIZE_MAX 50

int aws_iot_client_init(void);
void on_net_event_l4_connected(void);
void on_net_event_l4_disconnected(void);
void shadow_update_work_fn(struct k_work *work);
void connect_work_fn(struct k_work *work);
void aws_iot_event_handler(const struct aws_iot_evt *const evt);
int app_topics_subscribe(void);
void mqtttopic_handler(const struct aws_iot_evt *const evt);

#define CONFIG_SET_TOPIC "/set_config"
#define CONFIG_GET_TOPIC "/get_config"
#define DATA_FROM_CLOUD_TOPIC "/data_from_cloud"
#define DATA_TO_CLOUD_TOPIC "/data_to_cloud"

#endif
```
