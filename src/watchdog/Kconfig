## src/watchdog/Kconfig
```kconfig
#
# Copyright (c) 2021 Nordic Semiconductor
#
# SPDX-License-Identifier: LicenseRef-Nordic-5-Clause
#

menuconfig WATCHDOG_APPLICATION
	bool "Application watchdog"
	select WATCHDOG
	default y

if WATCHDOG_APPLICATION
if DL40_MODEM_UPDATE_SD
config WATCHDOG_APPLICATION_TIMEOUT_SEC
	 int "Application watchdog timeout in seconds"
	 default 420	
endif

config WATCHDOG_APPLICATION_TIMEOUT_SEC
	 int "Application watchdog timeout in seconds" 
	 default 360


endif # WATCHDOG_APPLICATION

module = WATCHDOG
module-str = Watchdog
source "subsys/logging/Kconfig.template.log_config"
```
